## CMakeLists.txt
```
cmake_minimum_required(VERSION 3.13)

set(CMAKE_EXPORT_COMPILE_COMMANDS ON)

# 设置默认板型 (如果未在命令行指定)
if(NOT DEFINED BOARD)
    set(BOARD "arcs_mini")
    message(STATUS "Using default BOARD: ${BOARD}")
endif()

# 板型专属配置：存在 <BOARD>.conf 时自动合并，覆盖 prj.conf 中的默认值
if(EXISTS ${CMAKE_CURRENT_SOURCE_DIR}/${BOARD}.conf)
    list(APPEND CONFIG_FILES ${CMAKE_CURRENT_SOURCE_DIR}/${BOARD}.conf)
    message(STATUS "Added board config: ${BOARD}.conf")
endif()

find_package(listenai-cmake REQUIRED HINTS $ENV{ARCS_BASE})

project(arcs-mini)

include(version.cmake)

add_definitions(-DLISTEN_CLOUD -DCONFIG_EXT_RAM)

# Add original arcs-mini path to include directories so its services can find each other
listenai_include_directories(../arcs-mini)

# Add project root directory to include path for app-config-tls-generic.h and memap.h
listenai_include_directories(${CMAKE_CURRENT_SOURCE_DIR})
# Get project root directory (two levels up from apps/aopu-yuba)
get_filename_component(PROJECT_TOP_DIR ${CMAKE_CURRENT_SOURCE_DIR}/../.. ABSOLUTE)
message (STATUS "PROJECT_TOP_DIR: ${PROJECT_TOP_DIR}")
# Python 3 is discovered by the SDK; reuse the cached Python3_EXECUTABLE.
set(PYTHON3 ${Python3_EXECUTABLE})

add_subdirectory(${PROJECT_TOP_DIR}/modules ${CMAKE_BINARY_DIR}/modules)
add_subdirectory(${PROJECT_TOP_DIR}/src ${CMAKE_BINARY_DIR}/src)

if (DEFINED CONFIG_APPLICATION_UI)
    add_subdirectory(${PROJECT_TOP_DIR}/apps-ui ${CMAKE_BINARY_DIR}/apps-ui)
endif()

add_subdirectory(${PROJECT_TOP_DIR}/apps/arcs-mini/tone ${CMAKE_BINARY_DIR}/tone)
add_subdirectory(${PROJECT_TOP_DIR}/apps/arcs-mini/services ${CMAKE_BINARY_DIR}/services)
add_subdirectory(${PROJECT_TOP_DIR}/apps/arcs-mini/button ${CMAKE_BINARY_DIR}/button)
add_subdirectory(${PROJECT_TOP_DIR}/apps/arcs-mini/mcp-tools ${CMAKE_BINARY_DIR}/mcp-tools)
add_subdirectory(${PROJECT_TOP_DIR}/apps/arcs-mini/voice_intent ${CMAKE_BINARY_DIR}/voice_intent)
add_subdirectory(${PROJECT_TOP_DIR}/apps/arcs-mini/voice_player ${CMAKE_BINARY_DIR}/voice_player)

listenai_add_executable(${PROJECT_NAME})

# res 目录命名约定：<app-name>[_variant]，BOARD 去掉 "arcs_mini" 前缀后即变体后缀。
# 所有硬件/打包变体均应使用独立 BOARD，例如 arcs_mini_ls2663、arcs_mini3。
string(REGEX REPLACE "^arcs_mini" "" _VARIANT_SUFFIX "${BOARD}")
set(RES_DIR ${PROJECT_TOP_DIR}/res/arcs-mini${_VARIANT_SUFFIX})
set(COMBINED_HEX ${CMAKE_BINARY_DIR}/${PROJECT_NAME}${_VARIANT_SUFFIX}.combined.hex)
set(LPK ${CMAKE_BINARY_DIR}/${PROJECT_NAME}${_VARIANT_SUFFIX}.lpk)
set(OTA_TXZ ${CMAKE_BINARY_DIR}/${PROJECT_NAME}${_VARIANT_SUFFIX}-v${PROJECT_VERSION_STR}.ota.txz)

add_custom_target(
    combined_hex ALL
    COMMAND ${CMAKE_COMMAND} -E echo "-- Generating combined hex: ${COMBINED_HEX}"
    COMMAND ${PYTHON3} ${PROJECT_TOP_DIR}/tools/make_package.py
        --format hex
        --partition-table ${RES_DIR}/partition_table.json
        --var BUILD_DIR=${CMAKE_BINARY_DIR}
        ${COMBINED_HEX}
    WORKING_DIRECTORY ${CMAKE_BINARY_DIR}
)
add_dependencies(combined_hex ${PROJECT_NAME})

add_custom_target(
    lpk ALL
    COMMAND ${CMAKE_COMMAND} -E echo "-- Generating LPK: ${LPK}"
    COMMAND ${PYTHON3} ${PROJECT_TOP_DIR}/tools/make_package.py
        --format lpk
        --partition-table ${RES_DIR}/partition_table.json
        --var BUILD_DIR=${CMAKE_BINARY_DIR}
        ${LPK}
    WORKING_DIRECTORY ${CMAKE_BINARY_DIR}
)
add_dependencies(lpk ${PROJECT_NAME})

add_custom_target(
    ota_txz ALL
    COMMAND ${CMAKE_COMMAND} -E echo "-- Generating ota txz: ${OTA_TXZ}"
    COMMAND ${PYTHON3} ${PROJECT_TOP_DIR}/tools/make_package.py
        --format ota
        --partition-table ${RES_DIR}/partition_table.json
        --var BUILD_DIR=${CMAKE_BINARY_DIR}
        --ota-version ${PROJECT_VERSION_STR}
        ${OTA_TXZ}
    WORKING_DIRECTORY ${CMAKE_BINARY_DIR}
)
add_dependencies(ota_txz ${PROJECT_NAME})

# add_subdirectory(msgs)
# add_subdirectory(recognize)

target_include_directories(${PROJECT_NAME} PRIVATE 
    ${CMAKE_CURRENT_SOURCE_DIR}/src
    ${PROJECT_TOP_DIR}/src/middleware/ota
    ${PROJECT_TOP_DIR}/arcs-sdk/system/uboot/include
    ${PROJECT_TOP_DIR}/arcs-sdk/components/lisa_http
    ${PROJECT_TOP_DIR}/arcs-sdk/modules/lvgl8/src/extra/libs/qrcode
)

target_sources(
    ${PROJECT_NAME} PRIVATE
    src/main.c
    src/passport_app.c
    src/passport_core.c
    src/passport_net.c
    src/passport_store.c
    src/passport_ui.c
    src/passport_ota.c
    src/ui_pixel.c
    src/ui_pixel_math.c
    src/font_sm_cjk_16.c
)

target_link_options(${PROJECT_NAME} PRIVATE
    -Wl,--wrap,gettimeofday
    -Wl,--wrap,settimeofday
    -Wl,--wrap,time
    -Wl,--wrap,gmtime_r
)
```

## prj.conf
```kconfig
# 项目可根据需要在此文件中设置对应的配置
CONFIG_ARCS_HAL_WARNING_DISABLE=y
CONFIG_SDK_MODULE_EASYLOGGER=y
CONFIG_EASYLOGGER_LINE_BUF_SIZE=4096
CONFIG_BOOT_HART=n

# CONFIG_ARCS_HAL_DEBUG=y
CONFIG_MODULE_FREERTOS=y
CONFIG_MODULE_HEAP=y
CONFIG_LINK_OPTION_NOSYS_SPECS=y
CONFIG_FREERTOS_STATIC_ALLOCATION_ENABLE=y

CONFIG_ARCS_CP_CORE=y
#using mbedtls for hardware decoding(IF CONFIG_WX_SQLITE3_HARD_CODEC)
CONFIG_SDK_MODULE_MBEDTLS=y
CONFIG_CUSTOM_MBEDTLS_CFG_FILE=y
CONFIG_MBEDTLS_CFG_FILE="app-config-tls-generic.h"
# CONFIG_MBEDTLS_HARDWARE_AES=y
# CONFIG_MBEDTLS_HARDWARE_SHA1=y
# CONFIG_MBEDTLS_HARDWARE_SHA256=y
# CONFIG_MBEDTLS_HARDWARE_SHA512=y
# CONFIG_MBEDTLS_HARDWARE_AES_CCM=y
# CONFIG_MBEDTLS_HARDWARE_AES_GCM=y
# CONFIG_MBEDTLS_HARDWARE_ECC=y

# System support
CONFIG_MBEDTLS_HAVE_TIME_DATE=y
CONFIG_MBEDTLS_SSL_ALPN=y

CONFIG_MBEDTLS_ECDH_C=y
CONFIG_MBEDTLS_ECP_C=y
CONFIG_MBEDTLS_ECP_DP_SECP256R1_ENABLED=y
CONFIG_MBEDTLS_SSL_MAX_CONTENT_LEN=16384

# CONFIG_MBEDTLS_DEBUG=y

CONFIG_MBEDTLS_INTERNAL_MEM_ALLOC=n
CONFIG_MBEDTLS_EXTERNAL_MEM_ALLOC=y

CONFIG_LWIP=y
CONFIG_WIFI=y

CONFIG_ARCS_HAL_WLIF=y
CONFIG_ARCS_HAL_EVENT=y
CONFIG_ARCS_HAL_CLI_CMD=y
CONFIG_ARCS_HAL_UTILS=y

CONFIG_MODULE_ZE_TLS=y
CONFIG_MODULE_HTTPCLIENT=y
CONFIG_MODULE_NOPOLL=y
CONFIG_MODULE_CORESNTP=y
CONFIG_LWIP_OPTION_SO_REUSE=y
CONFIG_LWIP_OPTION_LWIP_DNS=y

CONFIG_MEM_CONFIG=n

# 默认 LS2684：CP=8M。使用 arcs_mini_ls2663.conf 时覆盖为 CP=5M。
# 两种配置均需与 memap.h 同步。
CONFIG_MEM_FLASH_BASE=0x30600000
CONFIG_MEM_PSRAM_BASE=0x28800000
CONFIG_MEM_PSRAM_SIZE=0x00800000

CONFIG_HEAP_SIZE=0x4800
CONFIG_BACK_TRACE=y

CONFIG_PSRAM_HEAP_SIZE=0x600000

CONFIG_DCACHE_ENABLE=y

# 使能collection-c
CONFIG_SDK_MODULE_COLLECTIONS_C=y

CONFIG_CJSON=y

CONFIG_MODULE_EASYFLASH=y

CONFIG_SDK_MODULE_LETTER_SHELL=y
CONFIG_SDK_MODULE_LETTER_SHELL_CONFIG_FILE="shell_cfg_user.h"


# USB device: CherryUSB UAC1/MSC with the SDK app-class ADB transport.
CONFIG_TINY_USB=n
CONFIG_TUSB_APP_CLASS=n
CONFIG_CHERRYUSB=y
CONFIG_CHERRYUSB_DEVICE=y
CONFIG_CHERRYUSB_DEVICE_SPEED_HS=y
CONFIG_CHERRYUSB_DEVICE_MUSB_LISA=y
CONFIG_CHERRYUSB_DEVICE_AUDIO=y
CONFIG_CHERRYUSB_DEVICE_MSC=y
CONFIG_CHERRYUSB_DEVICE_ADB=y
CONFIG_CHERRYUSB_DEVICE_TEMPLATE_NONE=n
CONFIG_CHERRYUSB_APP_CLASS=y
CONFIG_APP_USB_AUDIO_ENABLE=y
CONFIG_APP_USB_CDC_ENABLE=y
CONFIG_ADB=y
CONFIG_ADB_SYNC=n
CONFIG_ADB_REBOOT=y
CONFIG_ADB_SHELL=y
CONFIG_ADB_SHELL_BUFFER_SIZE=2048
CONFIG_ADB_SHELL_EARLY_LOG=n
CONFIG_ADB_PUSH_PULL_DEFAULT_ROOT="/SD:/adb/"


# 文件系统配置
CONFIG_FILE_SYSTEM=y
CONFIG_FATFS_FILESYSTEM=y
CONFIG_LSFS_REGISTER_VFS=y
CONFIG_LVFS=y
CONFIG_LVFS_POSIX_API=y
CONFIG_LVFS_POSIX_API_ALIAS=y
CONFIG_FATFS_FFCONF_NAME="sd_music/sd_music_fatfs_config.h"

# DISK驱动使能
CONFIG_DISK_DRIVER=y

# DISK SDMMC驱动使能及配置
CONFIG_DISK_DRIVER_SDMMC=y

# DISK FLASH驱动使能及配置
CONFIG_DISK_DRIVER_FLASH=y
CONFIG_DISK_FLASH_START_ADDR=0xF00000
CONFIG_DISK_FLASH_MAX_RW_SIZE=4096
CONFIG_DISK_FLASH_ERASE_ALIGNMENT=4096
CONFIG_DISK_FLASH_ERASE_BLOCK_SIZE=4096
CONFIG_DISK_FLASH_SECTOR_SIZE=4096
CONFIG_DISK_FLASH_VOLUME_SIZE=1048576

# 抽象文件系统
CONFIG_LSFS=y
CONFIG_LSFS_FAT=y
# DISK驱动使能
CONFIG_DISK_DRIVER=y


# 抽象文件系统
CONFIG_LSFS=y
CONFIG_LSFS_FAT=y
CONFIG_FS_ENV_MEMORY_MANAGEMENT_USE_PSRAM=y
#WIFI MANAGER

CONFIG_WIFI_MANAGER=y

CONFIG_EASYLOGGER_USE_POSIX_TIME=y
CONFIG_SDK_MODULE_COREHTTP=y
CONFIG_SDK_MODULE_SPEEXDSP=y
CONFIG_SDK_MODULE_MEMPOOL=y

CONFIG_SDK_MODULE_CURL=n
CONFIG_WIFI_MGR_NVS_PARTITION_OFFSET=0xff0000

# CONFIG_SDK_MODULE_LVGL8=y
# CONFIG_LV_DEMO_SYS_HEAP=y
# CONFIG_LV_DRIVER_PIXEL_ALIGN_SIZE=16
# CONFIG_LV_USE_DEMO_WIDGETS=y
# CONFIG_LV_USE_GPU_CSK_DMA2D=y
# CONFIG_LV_DOUBLE_VDB=y
# CONFIG_LV_USE_PERF_MONITOR=n
# CONFIG_LV_DRIVER_FULL_REFRESH=y
# CONFIG_LV_CUSTOM_MONITOR=n
# CONFIG_LV_REFR_UNCONDITIONAL_AREA_JOIN=y
# CONFIG_LV_DRIVER_ROTATE_90=y
# CONFIG_LV_CONF_SKIP=n
# CONFIG_LV_USE_RPC=n
# CONFIG_LV_USE_RPC_THRESHOLD=8000
# CONFIG_LV_CUSTOM_TASK_CPU_PER=n
# CONFIG_LV_IMG_CACHE_DEF_SIZE=30

# CONFIG_LV_FONT_FMT_TXT_LARGE=y


# CONFIG_EASYLOGGER_LOG_LEVEL_DEBUG=y

CONFIG_ARCS_HAL_LSF=y
CONFIG_IPC_LSF=y
CONFIG_LSF_CLIENT=y

CONFIG_WIFI_MANAGER=y

CONFIG_MAC_MANAGER=y
CONFIG_MAC_MANAGER_MAC_BY_CHIP_ID=y

CONFIG_APP_PLAYER=y
CONFIG_APP_PLAYER_AUDIO_FOCUS=y
CONFIG_APP_PLAYER_SEMAPHORE_WAIT_TIMEOUT_MS=10000
CONFIG_APP_PLAYER_CALLBACK_THREAD_STACK_SIZE=8192
CONFIG_ARCS_HAL_DCACHE_COHERENT=n
CONFIG_FREERTOS_FAST_FUNC_SECTION=".text"
CONFIG_ALARM_TEXT_MAX_LEN=384

CONFIG_LISA_OS=y
CONFIG_LISA_KV=y
CONFIG_LOG=y
CONFIG_DISK_MEM=n
CONFIG_DISK_MEM_SERVER=n
CONFIG_BOOT=n

CONFIG_LISA_NET=y
CONFIG_LISA_MODEM=y
CONFIG_BOARD_ARCS_MINI_MODEM_UART2_REMAP=y
CONFIG_SAL_USING_POSIX=y
CONFIG_LWIP=y
CONFIG_WIFI=y
CONFIG_WIFI_LWIP_SAME_CORE=y
CONFIG_LWIP_OPTION_LWIP_DNS=y
CONFIG_LWIP_OPTION_SO_REUSE=y
CONFIG_ARCS_HAL_WCND_GPADC_IC_MUTEX=n
CONFIG_ARCS_HAL_IC_MUTEX=n

# CONFIG_LISAUI=y
CONFIG_EBUS=y

#GPDMA
# CONFIG_ARCS_GPDMA_DATA_ONLY=y
CONFIG_ARCS_GPDMA_FULL_INIT=y
CONFIG_LWIP_TX_BUF_COPY=y
CONFIG_WIFI_TX_BUF_COPY=y

CONFIG_ARCS_HAL_WCND_RF_SELFCALI_FROM_NV=n
CONFIG_BATTERY_COLLECTION=y
CONFIG_FLEXIBLE_BUTTON=y

CONFIG_ARCS_HAL_IPC=y
CONFIG_ARCS_HAL_FLASH_IF=y
CONFIG_ARCS_HAL_IPC_FLASH_AGENT=y
CONFIG_ARCS_HAL_IPC_HALT_PEER_CORE=y

CONFIG_ARCS_HAL_NVS=y
CONFIG_BLE=y
CONFIG_BLE_PROFILE_HOGPD=y
CONFIG_BLE_PROFILE_NETCFG_BLES=y
CONFIG_BLE_PROFILE_BASS=y

CONFIG_LISA_KV_TYPE_EF=y
CONFIG_LS_EF_ENV_AREA_SIZE=32768

CONFIG_COMPILE_OPTION_WARNING_AS_ERROR=y
CONFIG_LISA_DISPLAY_COLOR_INVERT=y
CONFIG_SDK_MODULE_ICO=y

CONFIG_LOG_MODE_ASYNC=y
CONFIG_EASYLOGGER_LOG_MODE_ASYNC=y
CONFIG_LS_CHAT=y
# acomp
CONFIG_ACOMP=y
CONFIG_ACOMP_WAKEUP=y

# CONFIG_ACOMP_WAKEUP_AUDIO_IN_DUAL_MIC=y
# CONFIG_ACOMP_WAKEUP_RES_CAE_MLP_ADDRESS=0x30200000
# CONFIG_ACOMP_WAKEUP_RES_CAE_MLP_LENGTH=1182080

# CONFIG_ACOMP_WAKEUP_RES_ESR_MLP_ADDRESS=0x30330000
# CONFIG_ACOMP_WAKEUP_RES_ESR_MLP_LENGTH=1198464

# CONFIG_ACOMP_WAKEUP_RES_ESR_MAIN_ADDRESS=0x30460000
# CONFIG_ACOMP_WAKEUP_RES_ESR_MAIN_LENGTH=608

# CONFIG_ACOMP_WAKEUP_RES_ESR_CMDS_ADDRESS=0x30470000
# CONFIG_ACOMP_WAKEUP_RES_ESR_CMDS_LENGTH=11248

# CONFIG_ACOMP_WAKEUP_RES_CAE_WRAP_ADDRESS=0x30480000
# CONFIG_ACOMP_WAKEUP_RES_CAE_WRAP_LENGTH=262

# CONFIG_ACOMP_WAKEUP_RES_AI_WRAP_ADDRESS=0x30490000
# CONFIG_ACOMP_WAKEUP_RES_AI_WRAP_LENGTH=395

CONFIG_ACOMP_WAKEUP_ALGORITHM_TYPE_SINGLE_MIC=y
CONFIG_ACOMP_WAKEUP_RES_CAE_ESR_MLP_ADDRESS=0x30200000
CONFIG_ACOMP_WAKEUP_RES_CAE_ESR_MLP_LENGTH=1431296
CONFIG_ACOMP_WAKEUP_RES_AI_WRAP_ADDRESS=0x304D0000
CONFIG_ACOMP_WAKEUP_RES_AI_WRAP_LENGTH=763

CONFIG_BOOT_WITH_WATCHDOG=y
CONFIG_WATCHDOG_ENABLE=n

CONFIG_LITE_ADC=y
CONFIG_AADC_LR_MIX=y
CONFIG_LITE_AADC_RECV_CNTS=50
CONFIG_ECHO_RECV_CNTS=50
CONFIG_LITE_DAC=y
CONFIG_DAC_ECHO_ENABLE=n

CONFIG_PRINTF_LOG_REDIRECT=n

CONFIG_CLOUD_PRODUCT_ID_DEFAULT="cf75e7a9-66b6-41e3-918a-141800aebb5b"
CONFIG_CLOUD_SECRET_ID_DEFAULT="e354f1f0-34e5-488f-8ef2-f6db2a44c815"

CONFIG_CLOUD_FULL_DUPLEX_ENABLE=y
CONFIG_CLOUD_FULL_DUPLEX_TIMEOUT_MS=180000
CONFIG_CLOUD_IDLE_EXIT_TIMEOUT_MS=20000
CONFIG_CLOUD_STAGING_MODE_ENABLE=n

# CONFIG_BOARDS_CHOICE_CUSTOM=y
CONFIG_ACOMP_LOGGER=y
CONFIG_LS_CHAT_MCP_V2=y
CONFIG_NOPOLL_DELIVER_PONG_FRAME_ENABLED=y

#server
CONFIG_SERVER_VOICE_LSCHAT=y
CONFIG_MCP_TOOL_EMOJI_ENABLE=y
CONFIG_MCP_TOOL_CAMERA_ENABLE=y

CONFIG_LISA_SHELL=y
CONFIG_CONSOLE_UART_BACKEND=y

# LISA UART Driver
CONFIG_LISA_DEVICE=y
CONFIG_LISA_UART_DEVICE=y
CONFIG_LISA_UART0=y
CONFIG_LISA_UART1=y
CONFIG_LISA_UART2=y

CONFIG_LISA_WEBSOCKET=y
CONFIG_LISA_WEBSOCKET_PING_PONG_TIMEOUT_MS=3000
CONFIG_LISA_HTTP=y
CONFIG_WIFI_MANAGER=y
CONFIG_LISA_FLASH_ARCS_HALT_REMOTE_CORE=y

CONFIG_PA_PORT=0
CONFIG_PA_PIN=27
CONFIG_PA_FUNC=0

CONFIG_CATEGORY_MINI=y
CONFIG_ACOMP_WAKEUP_ALGORITHM_TYPE_DUAL_MIC=n


# LISA Audio Driver
CONFIG_LISA_AUDIO_DEVICE=y
CONFIG_LISA_AUDIO_RECORD_INDIVIDUAL_GAIN=y
CONFIG_LISA_AUDIO_PLAY_ECHO_ENABLE=n
CONFIG_LISA_AUDIO_PLAY_PA_ENABLE=n

#初始化gpio
CONFIG_LISA_GPIO_DEVICE=y
CONFIG_LISA_GPIOB=y
CONFIG_LISA_DEVICE=y
CONFIG_LISA_GPIO_DEVICE=y
CONFIG_LISA_GPIOA=y
CONFIG_LISA_GPIOB=y
CONFIG_LISA_PWM=y
CONFIG_LISA_SPI1=y

CONFIG_LISA_DISPLAY_DEVICE=y
CONFIG_LISA_DISPLAY_PANEL_ST7789P3=y
CONFIG_LISA_DISPLAY_TE_SYNC=y
CONFIG_LISA_DISPLAY_CPDMA_ROTATE=y
CONFIG_LISA_DISPLAY_BUS_SPI_4WIRE=y
CONFIG_PANEL_ST7789P3_WIDTH=240
CONFIG_PANEL_ST7789P3_HEIGHT=240
CONFIG_PANEL_ST7789P3_X_OFFSET=0

CONFIG_LISA_I2C=y
CONFIG_LISA_I2C0=y

CONFIG_SDK_MODULE_LVGL8=y
CONFIG_LV_DEMO_SYS_HEAP=y
CONFIG_LV_DRIVER_PIXEL_ALIGN_SIZE=16
CONFIG_LV_USE_DEMO_WIDGETS=y
CONFIG_LV_USE_GPU_CSK_DMA2D=y
CONFIG_LV_DOUBLE_VDB=y
CONFIG_LV_USE_PERF_MONITOR=n
CONFIG_LV_DRIVER_FULL_REFRESH=n
CONFIG_LV_CUSTOM_MONITOR=n
CONFIG_LV_REFR_UNCONDITIONAL_AREA_JOIN=n
CONFIG_LV_DRIVER_ROTATE_90=y
CONFIG_LISA_DISPLAY_DEVICE=y
CONFIG_LV_CONF_SKIP=y
CONFIG_SDK_MODULE_LIBPNG=y
CONFIG_SDK_MODULE_IJG=y
CONFIG_LVGL_HEAP_SIZE=0x100000
CONFIG_LISA_DISPLAY_COLOR_INVERT=y
CONFIG_LV_COLOR_DEPTH=16
CONFIG_LV_USE_PNG=y
CONFIG_LV_USE_BMP=y
CONFIG_LV_USE_SJPG=y
CONFIG_LISAUI=y
CONFIG_LV_USE_FONT_PLACEHOLDER=n
CONFIG_FILE_SYSTEM=y
CONFIG_LSFS=y
CONFIG_LSFS_FAT=y
CONFIG_FS_ENV_MEMORY_MANAGEMENT_USE_PSRAM=y

CONFIG_LISA_ADC=y
CONFIG_FLEXIBLE_BUTTON=y
CONFIG_APPLICATION_UI=y

CONFIG_LISA_I2C=y
CONFIG_LISA_I2C0=y

CONFIG_LISA_SPI_DEVICE=y
CONFIG_LISA_SPI0=y
CONFIG_LISA_UART_DEVICE=y
CONFIG_LISA_UART_ASYNC_API=y
CONFIG_LISA_UART1=y

CONFIG_LISA_CAMERA_DEVICE=y
CONFIG_LISA_CAMERA_BUS_DVP=y
CONFIG_LISA_CAMERA_SENSOR_GC0328=y

CONFIG_TONE=y
CONFIG_LISA_SHELL_TASK_PRIORITY=10
CONFIG_LISA_WIFI=y
CONFIG_LISA_WEBSOCKET_THREAD_PRIO=9

# Lisa Bluetooth
CONFIG_BLE=y
CONFIG_LISA_BLUETOOTH=y
CONFIG_LISA_BLUETOOTH_BLE=y
CONFIG_MEM_WFRAM_SIZE=0x00017000
CONFIG_MEM_SRAM_BASE=0x20017000
CONFIG_MEM_SRAM_SIZE=0x00029000
CONFIG_BLE_PROFILE_HOGPD=y
CONFIG_BLE_PROFILE_NETCFG_BLES=y
CONFIG_LISA_BLUETOOTH_CUSTOM_NETCFG=y
CONFIG_BLE_PROFILE_BASS=y
CONFIG_LWIP_NETAL_TX_SMALL_BUF_CNT=40
CONFIG_LWIP_NETAL_TX_BUF_CNT=15

CONFIG_POWER_MANAGER=y
CONFIG_POWER_MANAGER_POWER_EN_GPIO_PAD="gpiob"
CONFIG_POWER_MANAGER_POWER_KEY_GPIO_PAD="gpiob"
CONFIG_POWER_MANAGER_USB_DETECT_GPIO_PAD="gpiob"

CONFIG_BATTERY_COLLECTION=y
CONFIG_BATTERY_COLLECTION_ADC_PAD="gpiob"
CONFIG_BATTERY_COLLECTION_ADC_CHANNEL=3
CONFIG_BATTERY_COLLECTION_CHARGE_DETECT_PAD="gpiob"

CONFIG_OTA=y
CONFIG_MIDDLEWARE_SD_MUSIC=y
CONFIG_LOG_UPLOAD=y

# 系统 OTA 需要 uboot 提供的 APP 侧公共 API，和 boot 的 control store 对齐。
# boot 侧：CONFIG_BOOT_ADB_SYNC=y 时 store 基址默认 0x3003E000，参见
# arcs-sdk/system/uboot/Kconfig.public。APP 侧必须显式锁定到同一地址。
CONFIG_BOOT_OTA_API=y
CONFIG_BOOT_CONTROL_STORE_FLASH=y
CONFIG_BOOT_CONTROL_STORE_BASE_ADDR=0x3003E000
CONFIG_BOOT_CONTROL_STORE_SIZE=4096

# USB 插着时的软关机路径
CONFIG_BOOT_POWER_API=y

# 运行时探测 boot 特性以兼容老 boot
CONFIG_BOOT_FEATURES_API=y

CONFIG_AUDIO_DEFAULT_MIC_GAIN_A_DB=36
CONFIG_AUDIO_DEFAULT_MIC_GAIN_D_DB=0
CONFIG_AUDIO_DEFAULT_REF_GAIN_A_DB=26
CONFIG_AUDIO_DEFAULT_REF_GAIN_D_DB=0
CONFIG_AUDIO_DEFAULT_SPK_GAIN_A_DB=-2
CONFIG_AUDIO_DEFAULT_SPK_GAIN_D_DB=-19
CONFIG_LSCHAT_WAKEUP_CLOUD_NOISE_GATE_THRESHOLD=256

# 闹钟响铃时长
CONFIG_ALARM_RING_DURATION_MS=900000
CONFIG_ALARM_RING_AUTO_RETURN_MS=900000

# tts字幕时间
CONFIG_TTS_TEXT_MS_PER_CHAR=250

# 默认系统音量（KV 无记录时使用）
CONFIG_VOICE_PLAYER_DEFAULT_VOLUME=70

CONFIG_MEM_LUNA_SHARED_BASE=0x20042000
CONFIG_MEM_LUNA_SHARED_SIZE=0x00007000

CONFIG_MEM_IPC_BASE=0x20040000
CONFIG_MEM_IPC_SIZE=0x00002000

CONFIG_MEM_APRAM_BASE=0x20058800
CONFIG_MEM_APRAM_SIZE=0x00057800
CONFIG_LV_FONT_MONTSERRAT_20=y

CONFIG_APPLICATION_UI=y
CONFIG_LISAUI=y
CONFIG_LISA_DISPLAY_DEVICE=y

CONFIG_LV_USE_FONT_COMPRESSED=y

CONFIG_LV_FONT_MONTSERRAT_14=y
CONFIG_LV_FONT_MONTSERRAT_20=y
CONFIG_LV_FONT_SIMSUN_16_CJK=y
```

## src/main.c
```c
#include "FreeRTOS.h"
#include "task.h"
#include "lisa_log.h"
#include "voice_msg.h"
#include "bsp_button.h"
#include "passport_app.h"

#define TAG "main"

#include "button_blecfg.h"
#include "passport_net.h"
#include "passport_ota.h"

extern void passport_app_on_key(bsp_btn_t btn, bsp_btn_ev_t ev);

static void voice_msg_button_evt_handler(void *unused, uint32_t msg_id, void *data, uint32_t len, void *user_data) {
    const voice_msg_button_evt_t *evt = (const voice_msg_button_evt_t *)data;
    if (evt == NULL || len < sizeof(*evt)) return;

    bsp_btn_t btn;
    bsp_btn_ev_t ev;

    // 单按键逻辑替代（纯净开发）：
    // 短按 -> 相当于按 DOWN（用于移动光标/翻页）
    // 双击 -> 相当于按 OK（用于确认选择）
    // 长按 -> 相当于 OK 长按（用于返回菜单）
    // 5次及以上连击 -> 进入 BLE 配网
    switch (evt->action) {
        case VOICE_MSG_BUTTON_ACTION_CLICK:
            btn = BSP_BTN_DOWN;
            ev = BSP_BTN_CLICK;
            break;
        case VOICE_MSG_BUTTON_ACTION_DOUBLE_CLICK:
            btn = BSP_BTN_OK;
            ev = BSP_BTN_CLICK;
            break;
        case VOICE_MSG_BUTTON_ACTION_LONG_HOLD:
            btn = BSP_BTN_OK;
            ev = BSP_BTN_LONG;
            break;
        case VOICE_MSG_BUTTON_ACTION_QUINTUPLE_CLICK:
        case VOICE_MSG_BUTTON_ACTION_SEXTUPLE_CLICK:
        case VOICE_MSG_BUTTON_ACTION_SEPTUPLE_CLICK:
        case VOICE_MSG_BUTTON_ACTION_REPEAT_CLICK:
            button_blecfg_start();
            return;
        default:
            return;
    }

    passport_app_on_key(btn, ev);
}

static void voice_msg_network_evt_handler(void *unused, uint32_t msg_id, void *data, uint32_t len, void *user_data) {
    if (msg_id == VOICE_MSG_WIFI_CONNECTED || 
        msg_id == VOICE_MSG_WIFI_IP_GOT || 
        msg_id == VOICE_MSG_SYSTEM_NETWORK_PROBE_SUCCESS) {
        LISA_LOGI(TAG, "Network is ready! Triggering SYNC and checking OTA version...");
        passport_net_request(PASSPORT_NET_REQ_SYNC);
        passport_ota_check_version_async();
    }
}

int main(int argc, char **argv)
{
    extern int boot_watchdog_feed(void);
    boot_watchdog_feed();

    LISA_LOGI(TAG, "Starting sparkminds-passport on ARCS-MINI");

    extern int service_led_init(void);
    service_led_init();
    extern int service_volume_init(void);
    service_volume_init();
    extern int service_brightness_init(void);
    service_brightness_init();
    extern int service_button_init(void);
    service_button_init();
    extern int service_image_init(void);
    service_image_init();
    extern int service_camera_init(void);
    service_camera_init();
    
    // app_button_init(); // Optional if not used

#if CONFIG_APPLICATION_UI
    extern int lisa_ui_init(void);
    lisa_ui_init();
#endif

    extern int battery_init(void);
    battery_init();

    button_blecfg_init();
    voice_msg_sub(VOICE_MSG_BUTTON_CHANGE, voice_msg_button_evt_handler, NULL);
    voice_msg_sub(VOICE_MSG_WIFI_CONNECTED, voice_msg_network_evt_handler, NULL);
    voice_msg_sub(VOICE_MSG_WIFI_IP_GOT, voice_msg_network_evt_handler, NULL);
    voice_msg_sub(VOICE_MSG_SYSTEM_NETWORK_PROBE_SUCCESS, voice_msg_network_evt_handler, NULL);

    // Init passport application
    passport_app_start();

    while (1) {
        boot_watchdog_feed();
        vTaskDelay(pdMS_TO_TICKS(100));
    }

    return 0;
}
```

## src/passport_app.c
```c
// main/passport_app.c —— 创智学员 Passport 应用主体 (ARCS-MINI 适配版)。
// 移除了依赖于 ESP-IDF 的独立电源管理和休眠逻辑，因为 ARCS-MINI 具备完整的电池/屏幕/唤醒管理服务。
#include "passport_app.h"

#include "passport_core.h"
#include "passport_net.h"
#include "passport_store.h"
#include "passport_ui.h"

#include "lisa_log.h"
#include "lisa_log.h"
#include "lisa_device.h"
#include "lisa_display.h"
#include "sys_wifi.h"
#include "sys_network_manager.h"

#include "FreeRTOS.h"
#include "queue.h"
#include "task.h"
#include "lvgl.h"

#include <stdio.h>
#include <stdlib.h>
#include <string.h>
#include <sys/time.h>

#include "service_brightness.h"
#include "battery.h"

static const char *TAG = "smpass_app";

#define SCREEN_OFF_TIMEOUT_S 60           // 1 分钟无操作自动熄屏

static uint32_t s_idle_seconds = 0;
static bool     s_screen_off = false;
static int      s_saved_brightness = 100;
static bool     s_last_usb = false;

#define KEY_QUEUE_LEN      8
#define UI_QUEUE_LEN       8
#define HEARTBEAT_PERIOD_S 120           // 2 分钟心跳（服务端超时15分钟，提供充分容错）
#define SYNC_FALLBACK_S    3600          // 每小时兜底同步
#define BOOT_SYNC_DELAY_S  3

typedef struct {
    bsp_btn_t btn;
    bsp_btn_ev_t ev;
} key_evt_t;

typedef enum {
    MODE_PASSPORT = 0,
    MODE_LEGACY_DEMO,
} app_mode_t;

static QueueHandle_t s_key_queue;
static QueueHandle_t s_ui_queue;
static app_mode_t    s_mode = MODE_PASSPORT;
static int64_t       s_last_heartbeat_s;
static int64_t       s_last_sync_s;
static bool          s_boot_sync_done;

// 替换原有的 bsp_lvgl_lock。在 arcs_mini 中，LVGL 有独立的互斥锁或通过 LISA_UI_INVOKE_UI 投递。
// 简易起见，此处假设 LVGL_MUTEX 可用，或者假设回调已经在 LVGL 线程中。
// 为了编译通过并且不至于立刻 crash，先提供桩函数，实际生产需对接 lisa_ui_mutex。
bool bsp_lvgl_lock(int timeout_ms) { return true; }
void bsp_lvgl_unlock(void) {}

// ---------------------------------------------------------------------------
// dispatch 定时器
// ---------------------------------------------------------------------------
static void enter_legacy_demo(void)
{
    s_mode = MODE_LEGACY_DEMO;
    legacy_menu_enter();
}

static void handle_key(key_evt_t evt)
{
    if (s_mode == MODE_LEGACY_DEMO) {
        return;
    }

    s_idle_seconds = 0;

    // 若当前处于熄屏状态，点亮屏幕并忽略该次按键（防误触）
    if (s_screen_off) {
        s_screen_off = false;
        int target = s_saved_brightness > 0 ? s_saved_brightness : 100;
        service_brightness_set_temp(target);
        if (s_mode == MODE_PASSPORT) {
            passport_ui_show(passport_ui_current());
            passport_ui_tick();
        }
        LISA_LOGI(TAG, "Screen woke up by key press");
        return;
    }

    // 全局：OK 长按返回菜单
    if (evt.btn == BSP_BTN_OK && evt.ev == BSP_BTN_LONG &&
        passport_ui_current() != PASSPORT_SCREEN_MENU) {
        passport_ui_show(PASSPORT_SCREEN_MENU);
        return;
    }
    if (evt.btn == BSP_BTN_OK && evt.ev == BSP_BTN_LONG &&
        passport_ui_current() == PASSPORT_SCREEN_MENU) {
        return;
    }

    passport_ui_handle_key(evt.btn, evt.ev);
}

static uint32_t now_ts(void)
{
    struct timeval tv;
    gettimeofday(&tv, NULL);
    return (uint32_t)tv.tv_sec;
}


static void second_tick(void)
{
    int64_t now_s = (int64_t)xTaskGetTickCount() * portTICK_PERIOD_MS / 1000;

    static bool s_time_was_valid = false;
    if (!s_time_was_valid && passport_time_is_valid(now_ts())) {
        s_time_was_valid = true;
        passport_ui_evt_t evt = { .type = PASSPORT_UI_EVT_TIME_VALID, .arg1 = 0 };
        if (s_ui_queue) xQueueSend(s_ui_queue, &evt, 0);
    }

    // USB 插拔事件检测：插拔时唤醒屏幕并刷新
    bool cur_usb = battery_usb_plugged_stable_get();
    if (cur_usb != s_last_usb) {
        s_last_usb = cur_usb;
        s_idle_seconds = 0;
        if (s_screen_off) {
            s_screen_off = false;
            int target = s_saved_brightness > 0 ? s_saved_brightness : 100;
            service_brightness_set_temp(target);
            if (s_mode == MODE_PASSPORT) {
                passport_ui_show(passport_ui_current());
                passport_ui_tick();
            }
            LISA_LOGI(TAG, "Screen woke up by USB change");
        }
    }

    // 无操作 60 秒（1 分钟）自动熄屏
    if (!s_screen_off) {
        if (++s_idle_seconds >= SCREEN_OFF_TIMEOUT_S) {
            s_screen_off = true;
            s_saved_brightness = service_brightness_get();
            if (s_saved_brightness <= 0) s_saved_brightness = 100;
            service_brightness_set_temp(0);
            passport_ui_clear_sensitive();
            LISA_LOGI(TAG, "Auto screen off after %d seconds idle", SCREEN_OFF_TIMEOUT_S);
        }
    }

    if (!s_screen_off && s_mode == MODE_PASSPORT) passport_ui_tick();

    // 开机一次性同步
    if (!s_boot_sync_done && now_s >= BOOT_SYNC_DELAY_S) {
        s_boot_sync_done = true;
        s_last_sync_s = now_s;
        if (passport_store_is_provisioned()) {
            passport_net_request(PASSPORT_NET_REQ_SYNC);
        }
    }

    // 每小时兜底同步
    if (s_boot_sync_done && now_s - s_last_sync_s >= SYNC_FALLBACK_S &&
        !passport_net_is_busy()) {
        s_last_sync_s = now_s;
        if (passport_store_is_provisioned()) {
            passport_net_request(PASSPORT_NET_REQ_SYNC);
        }
    }
    // 维持 10 分钟心跳节奏
    if (now_s - s_last_heartbeat_s >= HEARTBEAT_PERIOD_S &&
        !passport_net_is_busy()) {
        s_last_heartbeat_s = now_s;
        if (passport_store_is_provisioned()) {
            passport_net_request(PASSPORT_NET_REQ_HEARTBEAT);
        }
    }
    
    // 如果还没校时，强制触发一次 NTP 更新（假设网络可能是好但 NTP 没运行）
    // if (!sys_time_is_sync()) {
    //     sys_time_sync();
    // }
}

static void dispatch_cb(lv_timer_t *timer)
{
    (void)timer;
    static int s_tick_div;
    static bool s_first_run = true;

    if (s_first_run) {
        s_first_run = false;
        // 恢复：显示主菜单
        passport_ui_show(PASSPORT_SCREEN_MENU);
    }

    key_evt_t key;
    while (xQueueReceive(s_key_queue, &key, 0) == pdTRUE) {
        handle_key(key);
    }
    
    // UI 队列事件处理 (暂无网络模块，但可接收内部UI事件)
    passport_ui_evt_t evt;
    while (xQueueReceive(s_ui_queue, &evt, 0) == pdTRUE) {
        if (s_mode == MODE_PASSPORT) {
            passport_ui_on_net_event(&evt);
        }
    }

    if (++s_tick_div >= 10) {   // 100ms × 10 = 1s
        s_tick_div = 0;
        second_tick();
    }
}

// ---------------------------------------------------------------------------
// 供 main.c (arcs_mini) 调用的按键入口
// ---------------------------------------------------------------------------
void passport_app_on_key(bsp_btn_t btn, bsp_btn_ev_t ev)
{
    if (!s_key_queue) return;
    key_evt_t evt = { .btn = btn, .ev = ev };
    xQueueSend(s_key_queue, &evt, 0);
}

// ---------------------------------------------------------------------------
// 入口
// ---------------------------------------------------------------------------
// ---------------------------------------------------------------------------
// 学员身份花名册（官方后台绑定凭证）
// ---------------------------------------------------------------------------
typedef struct {
    const char *name;
    const char *student_id;
    const char *secret_hex;
} student_entry_t;

static const student_entry_t S_STUDENTS[] = {
    { "梁根润", "SM-2026-001", "8900f114af58cb2989c7856e0c93a49d39ad1f8e2f756d682540a7d6266ee37d" },
    { "陆昭闻（Owen）", "SM-2026-002", "9d6a4ea3a3f9802a40969b4676c65b73035e6cdcc1c4b970661c4f61b79c2819" },
    { "仇绍恒", "SM-2026-003", "32fa28d5be83704fd8eb77d19b6b8f9f1061fa77449f20d1d56a381ecea5aade" },
    { "梁根珹", "SM-2026-004", "913240fb10d0009522253bb392764b6ec1453c57fd328cd178ae7bc3a7eb9e65" },
    { "季煦", "SM-2026-005", "8bda00bab6bb56312e331e81850e5feb3cafe9334d225c89859954c893e93797" },
    { "王之谦", "SM-2026-006", "d3df7c02ca477729de047b2c576a4b03274c0c80957bce3599e58e51a5d1841b" },
    { "梁子锟 Lewis", "SM-2026-008", "2705b81ed5b97d43f747083ca7f2ae26026dda0551556edd95bbcf429c87718b" },
    { "林光磊", "SM-2026-009", "969ab850c1f6ea4790b37678f52c91b27669d36e91c9d5c2de67583a81253506" },
    { "李晋桥", "SM-2026-010", "1027d47a7915bb3f3d994257f3bec1507f3cbac52f981a21c5b2236471a406ea" },
    { "彭涂文轩", "SM-2026-011", "cdc50c859dcfd973d1e8d4174f12ddd7cf015cbc6d65cbf043fffd0ab9ba8b46" },
    { "赵玮麒", "SM-2026-012", "18887fba0e15447f6be86be817b6efaff41f5a6e4d05855867ed0feb25b7dda5" },
    { "徐一潇（Jeremy）", "SM-2026-013", "155e787acf59d130ce453fe22a498281098f0abce690d7049f0f8ee6c0c2aab1" },
    { "金骏轩", "SM-2026-014", "6b17ed40ce56324164556dfbd260cbe2bc4c81b0b212887c420a0a2d1c3af479" },
    { "李泓毅", "SM-2026-015", "29e716d804fc5b1544ae9905b818465397b118e5323fab3a26e26a46d1e64185" },
    { "邓远涛", "SM-2026-016", "e5e782a043e681cc7e775a4b725f2cad817241709040976bc0a0fa2dd0659fd7" },
    { "曾顺鑫", "SM-2026-017", "5c7de29d95200827e8fdf1800873fb5da56c71ce25a01cd0583422731507f73d" },
    { "张楚越", "SM-2026-018", "484ef858d525170c4cdac1b9c8d5c7bd79bf5bd2279ca354d0b4dd1818cda28d" },
    { "杨聿筠", "SM-2026-019", "9c513884dcc619bb23bffc3a79321f402fa417646f897cf23f5927edaec0ed6f" },
    { "赵可昕", "SM-2026-020", "7306eee006293851d8163f7e535ad0fb25edb08383bbdae412f44f117a115299" },
    { "陆思行", "SM-2026-021", "1719415dbd359ab711cd6c277bcf494f2814cffd6838e829fe25dcdb3cc543ea" },
    { "陈家熠", "SM-2026-022", "823984ae1dd8de9b00031589cb519220324d571baed298198f45c384a39204e1" },
    { "汪楚轩", "SM-2026-023", "2a99531e835a9c8c8c93ca6e72212f03163a1e54717f4dbd1cf70ced935bdd36" },
    { "叶文湛", "SM-2026-024", "8fa3f95ec221a414e9e562058bec48b67e86412392a519e05b01bd745d3c9efc" },
    { "肖臻耀", "SM-2026-025", "081377a101bb6c7fc8d865647bf505785d937b848bf7a6dba0006ea8ce5f7762" },
    { "陈昭阳", "SM-2026-026", "7b31e78de08c59a34b7f667d8e7d933d908d21de82045f733b41dd5332893681" },
    { "陈昭坤", "SM-2026-027", "766cc3b0fa006707c74f1e4f82778bbdda4ebcd501943df6af0c844b16a2ee82" },
    { "陈昭信", "SM-2026-028", "eaef784f404093f2669da08e7268bfe7ddb19c911ae35adddf155ed03e267cfb" },
    { "韩瑞光", "SM-2026-029", "2d6f922d4aaae4d3aa1df96af6cff8affb6b61b2b373b8fc04e1e4cf528f4a55" },
    { "李子澍", "SM-2026-030", "1e504e586cc6288517590541aea925bbbcad325a2fd8de35a17acd28197d49bd" },
    { "杨明晗", "SM-2026-032", "bc6da98e969f802fd569224b46fe4522fc254014cf3cbf4db46b399ab00865a0" },
    { "孙子恒", "SM-2026-033", "2a74c40df098eeb75e36d29f50a2dd7ce15b41fbf841710555b793a55dae37e6" },
    { "敬彦博", "SM-2026-034", "4cb640849e06611dc23372b2926d113a934dae9079ff7e589f1ec16ca4073fae" },
    { "Aiden(郑皓羽)", "SM-2026-035", "45b13d7021320fe6c89b302b6c32c1d5582e0d4558aa9d8ee948a90cdf3eb72b" },
    { "傅韦锜", "SM-2026-036", "b5cd34288e8fe76484ee8566b19cb3dffca753199fec1d747449d77eea83c3ce" },
    { "邱泰宁", "SM-2026-037", "9583a30d6c3d883e0493817fdfa752edffc2ade18cb072cf04dc307db8614e33" },
    { "张哲宁", "SM-2026-038", "1fc42adb5b3b2706fb90aef61bcbaea533e074b88366523810dbc8bd0b00763e" },
    { "郭光正", "SM-2026-039", "f813b5a9a1656d5f0f30561e485f8d5872d5dd831cf84a41584e633c06340e75" },
    { "冼可晴", "SM-2026-040", "efb2d9a2941b86532af860c12cc19ccae71ac487486d9dfe6b3f43c5d00a0ec7" },
    { "贺祺珺", "SM-2026-041", "02756b5fbb8da67b4afa220616fc33d0338ae5dedef7d3e30f56453359211a19" },
    { "陈隽扬", "SM-2026-042", "39fc939a35f0eff3243ce90bcfbffa5a8db80e9ec4564d3e6dec340736469f40" },
    { "陈合雅", "SM-2026-043", "8a7fe66244866b64010d15f674fd5511144142bb08fe30b82564995d47fdacc2" },
    { "翁晞然", "SM-2026-044", "9842a76ec7afcf9e27757c493c74bfc63139559733c588f94072920af8b50d71" },
    { "严韬捷", "SM-2026-045", "88e52debe3ac628e5f249e833233d2e3b3eb593a5b6e0fba3f32f8d060f10084" },
    { "吴京熹", "SM-2026-046", "108d2c11c54a0f37b75c26a713cb3dbc34470d9dec4097d4e17fb3c96749267a" },
    { "潘悦", "SM-2026-047", "b7b3010b3f7b22d4d62ae4bdaa5eef9fba899c79cd89308267fee1b0786181e8" },
    { "叶林熹", "SM-2026-048", "7975da5989305cf2a0e51d6919011e321a2debc39888d5da1358fac7428f8ece" },
    { "苏梓铭", "SM-2026-049", "7d219c78d34aebb283855156443cfa8f7ebd126a0526fecacdac19e592b05fa4" },
    { "邓沛恒", "SM-2026-050", "b93e66307dd278bc978bfffd15c02ccfa7d2f85348b1d09f921abd3e9cf4fd7a" },
    { "王宥森", "SM-2026-051", "2f2c7908e132801fb4bab69398c8d39e37192aa24af5a3a819c2e653d1a4ebed" },
    { "赖祉言", "SM-2026-052", "ffaab721da472a1704b9293caa431603d84bfa33ed06153e491520642a7a3999" },
    { "曾兆骐", "SM-2026-053", "f36653d8da756274040a22a13ad888055c8ca58fea91628ebfd227a0abadf2c9" },
    { "曾承浠", "SM-2026-054", "ad5df25773083ad19bac2a951ac16e12f25d96f8270f89da16e9e9e02ad5e626" },
    { "罗煜哲", "SM-2026-055", "56f1a328f8b78c7aae03823217405fb4af374f74e1d03a496b3abc00a56cdf83" },
    { "廖浩铖Jacob", "SM-2026-056", "e4488697bdad9e08bb2d47d2188d561e818e932dde92eb31d21b9331f0dc995e" },
    { "廖浩竣", "SM-2026-057", "c58e5ec8ca58e7db8f050f1541727997cb3d9c0787f3b500520d9f23b117ced3" },
    { "曹浩林", "SM-2026-058", "9047d0fad9ac14868473023b632f07d8d994ce018521458388901816b302e1fd" },
    { "李彬佑", "SM-2026-059", "031342e5f35e9e9936bd47acb359a3bda206dd0d32cca470315d6ef074c2e9fe" },
    { "陈乐哲", "SM-2026-060", "03230191069e4215d66029beafccf9c77cb8aa95e056bc3d7f2e3955f1117997" },
    { "刘馥瑞", "SM-2026-062", "9907a04bb6e972804252e1c864891ab388049d2998419a977ab529d36f997e6a" },
    { "曾汝元", "SM-2026-065", "b3c34a93c5d5476f6c349fd923df6e2d067d8324d30d732dc639211db24847fd" },
    { "吴宸合", "SM-2026-066", "a4d61819f4204c0193c69696602c9c2d373f8852226f0c55355065941c3424c8" },
    { "李骊铭", "SM-2026-067", "e93708d39a65534d848050254500a989a027033eab0afbff2f429c27d1d48cae" },
    { "测试学生", "SM-2026-068", "fd97846c3015f542058b2cb343428f97f088c0f0bb4c42e5afc827b7045d7dd7" },
    { "郭涵若 Cavin", "SM-2026-070", "4a043814904f8e31668012d1997f5d2ba313ad1f39a7b021553341b266b9678c" },
    { "劲宝", "SM-2026-071", "24e920f32367ed16b6bdd3cab755be224d979523bdaa191e033abe3ca6382027" },
    { "吴所谓", "SM-2026-072", "09153e8395c9c471d9bc431e753069e5aab6f2418ab69a58dcc4f22d79b075b2" },
    { "陈家祺", "SM-2026-073", "ec4b6706fd160039c44705b13b2ed73126dd4cd1ab5169431283cc650955004d" },
    { "陈品源 Berry", "SM-2026-074", "2c1603a784312b3af30631101583ed30cfe91d15b85085f424b875086a265bcd" },
    { "罗格", "SM-2026-075", "5bd4347c2241079767a2b70601591f69419b4d235ff5b66679c5d9a37ccf2689" },
    { "叶祖睿", "SM-2026-077", "a08d8a39aff77065ea6601ed017722cb1378e2afa3de4c65fc426cd58b409aca" },
    { "马逸竣", "SM-2026-078", "5cb499ffc3c3dd3e83c138d25f5f3fe7d58ec136e8a5ba96f66a9f65d191054c" },
    { "徐朗", "SM-2026-079", "09514a343500f885762ce26567fe797a3a6eacbe82590891cb82ebaca6eec7c0" },
    { "王英权", "SM-2026-080", "29721f97b1fa75ec2ff80907fb9fedc49bf1958077000eec0bb69909605b9952" },
    { "王英帅", "SM-2026-081", "3afbf2610b8cf96338e35a3632ebef4d8fe93d2643d7c4a307fbbf41d22d480e" },
    { "马明睿", "SM-2026-082", "5bad8d1ef5e4e8ff3dfc86a08585b00980d0b2f4e068cbe551aa07699aa25df2" },
    { "Baiting Wu", "SM-2026-083", "9cdf33b797be592fc5a5a6b0d501d2d639a4b4ed83da20aea5a806d41b719c5a" },
    { "Baimei Wu", "SM-2026-084", "5ebede2c5c4366bf67df9d2715fda539b592a0217d5d92aca6b93a5e451e697b" },
    { "彭涂文轩", "SM-2026-085", "cdaa455a8f92f071b8302e73f94e55b5a6e48188d71b58f40078f6c770da5857" },
    { "曹浩林", "SM-2026-143", "7456f9deb4a484ffeb394c2e6385b3f5b800c74961d58b6159bb1e3fd8488cd7" },
    { "Aiden Kwok", "SM-2026-193", "93fc265de7a4f6bb21d6f24dc65a502d861d2bb4d5dd1c3b979064bcd702f747" },
    { "Charlie", "SM-2026-197", "985c83e2c853103c95b0287e6ff0a9faca4b0e250cd53cb6d141c2812d88feda" },
    { "转化测试", "SM-2026-564", "752144a940571a30acdd61c84a6756dcad98b88c8e511223c89767f45da7ab9d" },
    { "Eric 金家熠", "SM-2026-565", "4cc41779c7a70d6475de87bb0f1267f5dfbceede55e39c137ae36c9b6aac5e3d" },
    { "许赞", "SM-2026-590", "1d9b4cf2c7efe65bad11a7c4d2ac31983f92d4c88161de6e68758330a39b9601" },
    { "Ewan赵亦宏", "SM-2026-591", "8610f8a3be32a35a5c0e152f43d0104182be7e2871137288fe31d01571ab6eed" },
    { "侯思远", "SM-2026-592", "31e24eec598d930f6f071646b7a85d9933ef0304fb06198b2a76bccfd9ddd443" },
    { "浠浠", "SM-2026-593", "db35e5197e933c03e080fbd283f3efc85f2b568100a9553fea687bf25de0474a" },
    { "林俊宇", "SM-2026-718", "e3c82b9ffe0f76006936a61383a9faaa54628a6ceffb1e815b577de97435e789" },
    { "向子珅", "SM-2026-790", "510e5b745d6d67d57112093f3c5c307a057f7058b995e2923f0cdaf0b3f9db6f" },
    { "郭怀骏", "SM-2026-884", "fd909e7f4235a754b2fd033c1e98c36adc24aff9b9509b4dcae0413921d0f4d5" },
    { "李政贤", "SM-2026-956", "6ec6e23ded152e3268f7b106b349a733642ecc7ca9ae91b2c67dec7a4ac2ba42" },
    { "唐嘉著", "SM-2026-967", "464b0ae668d229810f25219574900760cff7aaff0d249c078ecf49f92de41ca8" },
    { "创才学霸演示生", "SM-2026-CCXB-DEMO", "f39ae694c139c16066c0bca4e905e1f5919ab273ccdd973dc92a9d0a1fbdf5aa" },
    { "演示同学", "SM-2026-DEMO", "a65f481f2b0ae37b4cfe65a01b334c124659ea0ea3294dc3bca5e81a8e15662d" },
    { "Woody Du", "SM-2026-NEW", "7fc09c34ec7c2728b8bd37758ef64ba7c8d0ec0145b23b0b4a275473b73781ea" },
};

#define CURRENT_TARGET_STUDENT_ID "SM-2026-067"

static bool student_hex_to_bytes(const char *hex, uint8_t *bytes, size_t byte_len) {
    if (!hex || strlen(hex) != byte_len * 2) return false;
    for (size_t i = 0; i < byte_len; i++) {
        char byte_str[3] = {hex[i * 2], hex[i * 2 + 1], '\0'};
        bytes[i] = (uint8_t)strtoul(byte_str, NULL, 16);
    }
    return true;
}

static bool passport_provision_student(const char *student_id) {
    for (size_t i = 0; i < sizeof(S_STUDENTS)/sizeof(S_STUDENTS[0]); i++) {
        if (strcmp(S_STUDENTS[i].student_id, student_id) == 0 ||
            strstr(S_STUDENTS[i].student_id, student_id) != NULL) {
            uint8_t secret[32];
            if (student_hex_to_bytes(S_STUDENTS[i].secret_hex, secret, 32)) {
                LISA_LOGI(TAG, "正在写入学员身份：%s (%s)", S_STUDENTS[i].name, S_STUDENTS[i].student_id);
                lisa_kv_del(PASSPORT_KEY_PP_TOKEN);
                lisa_kv_del(PASSPORT_KEY_BALANCE);
                lisa_kv_del(PASSPORT_KEY_BALANCE_TS);
                lisa_kv_del(PASSPORT_KEY_NAME);
                lisa_kv_del(PASSPORT_KEY_STUDENT_ID);
                lisa_kv_del(PASSPORT_KEY_AVATAR_URL);
                passport_store_del_avatar();

                passport_store_provision(S_STUDENTS[i].student_id, secret);
                passport_store_set_string(PASSPORT_KEY_NAME, S_STUDENTS[i].name);
                passport_store_set_string(PASSPORT_KEY_STUDENT_ID, S_STUDENTS[i].student_id);
                LISA_LOGI(TAG, "写入成功！学员身份已就绪：%s (%s)", S_STUDENTS[i].name, S_STUDENTS[i].student_id);
                return true;
            }
        }
    }
    LISA_LOGE(TAG, "未在花名册中找到学员 ID: %s", student_id);
    return false;
}

// ---------------------------------------------------------------------------
// 入口
// ---------------------------------------------------------------------------
void passport_app_start(void)
{
    char existing_pid[32] = {0};
    int pid_ret = passport_store_get_string(PASSPORT_KEY_PID, existing_pid, sizeof(existing_pid));
    
    // 如果板内未绑定该学员或为出厂初始态，对齐写入指定学员身份
    if (pid_ret != ESP_OK || strlen(existing_pid) == 0 || strcmp(existing_pid, CURRENT_TARGET_STUDENT_ID) != 0) {
        LISA_LOGI(TAG, "初始化/对齐指定学员 -> %s", CURRENT_TARGET_STUDENT_ID);
        passport_provision_student(CURRENT_TARGET_STUDENT_ID);
    } else {
        LISA_LOGI(TAG, "检测到已有学员身份: %s，予以严格保护保留！", existing_pid);
    }

    // 确保开机屏幕亮度正常点亮 (100%)，清除可能残留的 0 亮度，并唤醒屏幕
    s_screen_off = false;
    s_idle_seconds = 0;
    s_saved_brightness = 100;
    service_brightness_set(100);
    lisa_device_t *disp = lisa_device_get("display");
    if (disp) {
        lisa_display_blanking_off(disp);
    }

    s_key_queue = xQueueCreate(KEY_QUEUE_LEN, sizeof(key_evt_t));
    s_ui_queue = xQueueCreate(UI_QUEUE_LEN, sizeof(passport_ui_evt_t));

    // 初始化网络
    passport_net_init(s_ui_queue);

    // 初始化 UI 组件和资源
    passport_ui_init(s_ui_queue);

    s_last_heartbeat_s = 0;
    s_last_sync_s = 0;

    lv_timer_create(dispatch_cb, 100, NULL);

    LISA_LOGI(TAG, "创智学员 Passport 就绪 (UI Only)");
}

#include "shell.h"

static int shell_provision_cmd(int argc, char *argv[])
{
    if (argc < 2) {
        LISA_LOGI(TAG, "用法: provision <学号后缀或完整学号，例如 070, 006, 013, 565, 051>");
        for (size_t i = 0; i < sizeof(S_STUDENTS)/sizeof(S_STUDENTS[0]); i++) {
            LISA_LOGI(TAG, "  - %s (%s)", S_STUDENTS[i].name, S_STUDENTS[i].student_id);
        }
        return -1;
    }
    bool ok = passport_provision_student(argv[1]);
    return ok ? 0 : -1;
}

SHELL_EXPORT_CMD(SHELL_CMD_PERMISSION(0) | SHELL_CMD_TYPE(SHELL_TYPE_CMD_MAIN) | SHELL_CMD_DISABLE_RETURN,
                 provision, shell_provision_cmd, "provision <student_id_or_suffix>");
```

## src/passport_core.c
```c
// main/passport_core.c —— 创智学员 Passport 纯逻辑层实现。
//
// 自带一个最小 SHA-256/HMAC-SHA256 实现（按 FIPS 180-4 编写），
// 使本模块在 host 与固件上行为逐位一致、且无任何外部依赖。
#include "passport_core.h"

#include <stdio.h>
#include <string.h>

// ---------------------------------------------------------------------------
// SHA-256（FIPS 180-4）
// ---------------------------------------------------------------------------

typedef struct {
    uint32_t state[8];
    uint64_t total_len;   // 已处理消息总字节数
    uint8_t  block[64];   // 未满一块的缓存
    size_t   block_len;
} sha256_ctx_t;

static const uint32_t K[64] = {
    0x428a2f98U, 0x71374491U, 0xb5c0fbcfU, 0xe9b5dba5U,
    0x3956c25bU, 0x59f111f1U, 0x923f82a4U, 0xab1c5ed5U,
    0xd807aa98U, 0x12835b01U, 0x243185beU, 0x550c7dc3U,
    0x72be5d74U, 0x80deb1feU, 0x9bdc06a7U, 0xc19bf174U,
    0xe49b69c1U, 0xefbe4786U, 0x0fc19dc6U, 0x240ca1ccU,
    0x2de92c6fU, 0x4a7484aaU, 0x5cb0a9dcU, 0x76f988daU,
    0x983e5152U, 0xa831c66dU, 0xb00327c8U, 0xbf597fc7U,
    0xc6e00bf3U, 0xd5a79147U, 0x06ca6351U, 0x14292967U,
    0x27b70a85U, 0x2e1b2138U, 0x4d2c6dfcU, 0x53380d13U,
    0x650a7354U, 0x766a0abbU, 0x81c2c92eU, 0x92722c85U,
    0xa2bfe8a1U, 0xa81a664bU, 0xc24b8b70U, 0xc76c51a3U,
    0xd192e819U, 0xd6990624U, 0xf40e3585U, 0x106aa070U,
    0x19a4c116U, 0x1e376c08U, 0x2748774cU, 0x34b0bcb5U,
    0x391c0cb3U, 0x4ed8aa4aU, 0x5b9cca4fU, 0x682e6ff3U,
    0x748f82eeU, 0x78a5636fU, 0x84c87814U, 0x8cc70208U,
    0x90befffaU, 0xa4506cebU, 0xbef9a3f7U, 0xc67178f2U,
};

static uint32_t rotr32(uint32_t x, unsigned n)
{
    return (x >> n) | (x << (32U - n));
}

static void sha256_compress(sha256_ctx_t *ctx, const uint8_t block[64])
{
    uint32_t w[64];
    for (int i = 0; i < 16; i++) {
        w[i] = ((uint32_t)block[i * 4] << 24) |
               ((uint32_t)block[i * 4 + 1] << 16) |
               ((uint32_t)block[i * 4 + 2] << 8) |
               ((uint32_t)block[i * 4 + 3]);
    }
    for (int i = 16; i < 64; i++) {
        uint32_t s0 = rotr32(w[i - 15], 7) ^ rotr32(w[i - 15], 18) ^ (w[i - 15] >> 3);
        uint32_t s1 = rotr32(w[i - 2], 17) ^ rotr32(w[i - 2], 19) ^ (w[i - 2] >> 10);
        w[i] = w[i - 16] + s0 + w[i - 7] + s1;
    }

    uint32_t a = ctx->state[0], b = ctx->state[1], c = ctx->state[2],
             d = ctx->state[3], e = ctx->state[4], f = ctx->state[5],
             g = ctx->state[6], h = ctx->state[7];

    for (int i = 0; i < 64; i++) {
        uint32_t s1 = rotr32(e, 6) ^ rotr32(e, 11) ^ rotr32(e, 25);
        uint32_t ch = (e & f) ^ (~e & g);
        uint32_t t1 = h + s1 + ch + K[i] + w[i];
        uint32_t s0 = rotr32(a, 2) ^ rotr32(a, 13) ^ rotr32(a, 22);
        uint32_t maj = (a & b) ^ (a & c) ^ (b & c);
        uint32_t t2 = s0 + maj;
        h = g; g = f; f = e; e = d + t1;
        d = c; c = b; b = a; a = t1 + t2;
    }

    ctx->state[0] += a; ctx->state[1] += b; ctx->state[2] += c;
    ctx->state[3] += d; ctx->state[4] += e; ctx->state[5] += f;
    ctx->state[6] += g; ctx->state[7] += h;
}

static void sha256_init(sha256_ctx_t *ctx)
{
    ctx->state[0] = 0x6a09e667U; ctx->state[1] = 0xbb67ae85U;
    ctx->state[2] = 0x3c6ef372U; ctx->state[3] = 0xa54ff53aU;
    ctx->state[4] = 0x510e527fU; ctx->state[5] = 0x9b05688cU;
    ctx->state[6] = 0x1f83d9abU; ctx->state[7] = 0x5be0cd19U;
    ctx->total_len = 0;
    ctx->block_len = 0;
}

static void sha256_update(sha256_ctx_t *ctx, const uint8_t *data, size_t len)
{
    ctx->total_len += len;
    while (len > 0) {
        size_t space = sizeof(ctx->block) - ctx->block_len;
        size_t take = len < space ? len : space;
        memcpy(ctx->block + ctx->block_len, data, take);
        ctx->block_len += take;
        data += take;
        len -= take;
        if (ctx->block_len == sizeof(ctx->block)) {
            sha256_compress(ctx, ctx->block);
            ctx->block_len = 0;
        }
    }
}

static void sha256_final(sha256_ctx_t *ctx, uint8_t out[32])
{
    uint64_t bit_len = ctx->total_len * 8U;

    uint8_t pad = 0x80;
    sha256_update(ctx, &pad, 1);
    uint8_t zero = 0x00;
    while (ctx->block_len != 56) {
        sha256_update(ctx, &zero, 1);
    }
    uint8_t len_bytes[8];
    for (int i = 0; i < 8; i++) {
        len_bytes[i] = (uint8_t)(bit_len >> (56 - i * 8));
    }
    // 手动追加长度，不再计入 total_len（已不需要）。
    memcpy(ctx->block + 56, len_bytes, 8);
    sha256_compress(ctx, ctx->block);

    for (int i = 0; i < 8; i++) {
        out[i * 4]     = (uint8_t)(ctx->state[i] >> 24);
        out[i * 4 + 1] = (uint8_t)(ctx->state[i] >> 16);
        out[i * 4 + 2] = (uint8_t)(ctx->state[i] >> 8);
        out[i * 4 + 3] = (uint8_t)(ctx->state[i]);
    }
}

static void sha256(const uint8_t *data, size_t len, uint8_t out[32])
{
    sha256_ctx_t ctx;
    sha256_init(&ctx);
    sha256_update(&ctx, data, len);
    sha256_final(&ctx, out);
}

// ---------------------------------------------------------------------------
// HMAC-SHA256（RFC 2104），密钥固定 32 字节，不长于块长，无需先哈希。
// ---------------------------------------------------------------------------

static void hmac_sha256(const uint8_t key[PASSPORT_SECRET_LEN],
                        const uint8_t *msg, size_t msg_len,
                        uint8_t out[32])
{
    uint8_t k_ipad[64];
    uint8_t k_opad[64];
    for (size_t i = 0; i < 64; i++) {
        uint8_t k = i < PASSPORT_SECRET_LEN ? key[i] : 0x00;
        k_ipad[i] = k ^ 0x36;
        k_opad[i] = k ^ 0x5c;
    }

    sha256_ctx_t ctx;
    uint8_t inner[32];

    sha256_init(&ctx);
    sha256_update(&ctx, k_ipad, sizeof(k_ipad));
    sha256_update(&ctx, msg, msg_len);
    sha256_final(&ctx, inner);

    sha256_init(&ctx);
    sha256_update(&ctx, k_opad, sizeof(k_opad));
    sha256_update(&ctx, inner, sizeof(inner));
    sha256_final(&ctx, out);

    // 清痕：中间密钥材料不留栈上残影（尽力而为）。
    memset(k_ipad, 0, sizeof(k_ipad));
    memset(k_opad, 0, sizeof(k_opad));
    memset(inner, 0, sizeof(inner));
}

// ---------------------------------------------------------------------------
// 公开 API
// ---------------------------------------------------------------------------

uint32_t passport_window(uint32_t ts)
{
    return ts / PASSPORT_WINDOW_SECONDS;
}

bool passport_time_is_valid(uint32_t ts)
{
    return ts >= PASSPORT_MIN_VALID_TS;
}

void passport_qr_code(const uint8_t secret[PASSPORT_SECRET_LEN],
                      const char *pid, uint32_t ts,
                      char out_code[PASSPORT_CODE_LEN + 1])
{
    char msg[96];
    int msg_len = snprintf(msg, sizeof(msg), "qr:%s:%lu",
                           pid, (unsigned long)passport_window(ts));

    uint8_t mac[32];
    hmac_sha256(secret, (const uint8_t *)msg, (size_t)msg_len, mac);

    uint32_t v = ((uint32_t)mac[0] << 24) | ((uint32_t)mac[1] << 16) |
                 ((uint32_t)mac[2] << 8) | (uint32_t)mac[3];
    snprintf(out_code, PASSPORT_CODE_LEN + 1, "%06lu",
             (unsigned long)(v % 1000000U));

    memset(mac, 0, sizeof(mac));
}

int passport_qr_url(const char *pid, uint32_t ts,
                    const char code[PASSPORT_CODE_LEN + 1],
                    char *buf, size_t buflen)
{
    int len = snprintf(buf, buflen, "%s?pid=%s&ts=%lu&c=%s",
                       PASSPORT_QR_BASE_URL, pid,
                       (unsigned long)ts, code);
    if (len < 0 || (size_t)len >= buflen) return -1;
    return len;
}

void passport_auth_sig(const uint8_t secret[PASSPORT_SECRET_LEN],
                       const char *pid, uint32_t ts,
                       char out_sig_hex[PASSPORT_SIG_HEX_LEN + 1])
{
    char msg[96];
    int msg_len = snprintf(msg, sizeof(msg), "auth:%s:%lu",
                           pid, (unsigned long)ts);

    uint8_t mac[32];
    hmac_sha256(secret, (const uint8_t *)msg, (size_t)msg_len, mac);

    static const char HEX[] = "0123456789abcdef";
    for (int i = 0; i < 32; i++) {
        out_sig_hex[i * 2]     = HEX[mac[i] >> 4];
        out_sig_hex[i * 2 + 1] = HEX[mac[i] & 0x0f];
    }
    out_sig_hex[PASSPORT_SIG_HEX_LEN] = '\0';

    memset(mac, 0, sizeof(mac));
}

void passport_avatar_pattern(const char *student_id,
                             uint8_t out[PASSPORT_AVATAR_SIZE][PASSPORT_AVATAR_SIZE])
{
    uint8_t digest[32];
    sha256((const uint8_t *)student_id, strlen(student_id), digest);

    // 左半 4 列取自哈希前 4 字节（每字节一列，位即像素），右半镜像。
    for (int r = 0; r < PASSPORT_AVATAR_SIZE; r++) {
        for (int c = 0; c < PASSPORT_AVATAR_SIZE / 2; c++) {
            uint8_t on = (uint8_t)((digest[c] >> r) & 1U);
            out[r][c] = on;
            out[r][PASSPORT_AVATAR_SIZE - 1 - c] = on;
        }
    }

    memset(digest, 0, sizeof(digest));
}
```

## src/passport_net.h
```c
// main/passport_net.h —— 网络任务：Wi-Fi 突发连接、SNTP 校时、HTTPS API 客户端。
//
// 对齐上游"进入时初始化、退出时释放"模式：每次同步/心跳是一次完整突发
// （连 Wi-Fi → 校时 → auth → 业务调用 → esp_wifi_stop），Wi-Fi 不常开。
// 本任务不直接操作任何 LVGL 对象；结果经 ui_queue 投递给 UI 上下文。
#pragma once

#include "FreeRTOS.h"
#include "queue.h"
#include "esp_err.h"
#include <stdbool.h>
#include <stdint.h>

typedef enum {
    PASSPORT_NET_REQ_SYNC = 1,   // 开机/积分页/兜底：auth → /passport/me → check-in → history
    PASSPORT_NET_REQ_HEARTBEAT,  // 在馆心跳（仅校区 SSID）
    PASSPORT_NET_REQ_CHECKIN,    // 每日打卡请求（POST /passport/check-in）
} passport_net_req_t;

typedef struct {
    int32_t delta;               // 积分变动（+20 / -100）
    char    text[24];            // 变动说明（到课/兑换…）
} passport_point_item_t;

#define PASSPORT_HISTORY_MAX 5

// 创建网络任务。ui_queue 元素类型为 passport_ui_evt_t（见 passport_ui.h）。
esp_err_t passport_net_init(QueueHandle_t ui_queue);

// 投递一次请求（队列缓冲，突发中合并）。
void passport_net_request(passport_net_req_t req);

// 是否正处于突发（联网/同步/心跳中）
bool passport_net_is_busy(void);

// 最近一次同步的积分流水（网络任务写、UI 读，内部有锁）
int passport_net_history(passport_point_item_t out[PASSPORT_HISTORY_MAX]);
```
